## config/boards/shields/kabarga/Kconfig.defconfig
```kconfig
# Copyright (c) 2020 The ZMK Contributors
# SPDX-License-Identifier: MIT
# original by aroum

if SHIELD_WANDERER

config ZMK_KEYBOARD_NAME
	default "Wanderer"

config ZMK_SPLIT
	default n

config USB_DEVICE_PRODUCT
	default "Wanderer"

config USB_DEVICE_VID
	default "0x0000"

config USB_DEVICE_PID
	default "0xFEED"

config USB_DEVICE_MANUFACTURER
	default "kaumovich"

endif
```
